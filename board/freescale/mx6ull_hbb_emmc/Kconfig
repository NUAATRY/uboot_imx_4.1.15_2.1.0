## board/freescale/mx6ull_hbb_emmc/Kconfig
```kconfig
if TARGET_MX6ULL_HBB_EMMC

config SYS_BOARD
	default "mx6ull_hbb_emmc"

config SYS_VENDOR
	default "freescale"

config SYS_CONFIG_NAME
	default "mx6ull_hbb_emmc"

endif
```
